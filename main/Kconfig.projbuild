## main/Kconfig.projbuild
```kconfig
menu "Example Configuration"

    config STORE_HISTORY
        bool "Store command history in flash"
        default y
        help
            Linenoise line editing library provides functions to save and load
            command history. If this option is enabled, initalizes a FAT filesystem
            and uses it to store command history.

endmenu

menu "NAT Router Uplink"

    choice UPLINK_TYPE
        prompt "Uplink interface"
        default WIFI_STA_UPLINK
        config WIFI_STA_UPLINK
            bool "WiFi STA"
        config ETH_UPLINK
            bool "Ethernet / USB modem (WiFi runs as AP only)"
    endchoice

    choice ETH_PHY_TYPE
        prompt "Uplink device"
        default ETH_PHY_SPI_W5500 if !SOC_EMAC_SUPPORTED
        default ETH_PHY_RMII_LAN8720
        depends on ETH_UPLINK
        config ETH_PHY_RMII_LAN8720
            bool "Built-in RMII, LAN8720 (e.g. WT32-ETH01, Olimex ESP32-POE-ISO)"
            depends on SOC_EMAC_SUPPORTED
        config ETH_PHY_SPI_W5500
            bool "External SPI, WIZnet W5500 (e.g. Waveshare ESP32-S3-ETH)"
            select ETH_USE_SPI_ETHERNET
            select ETH_SPI_ETHERNET_W5500
            help
                For chips with no built-in RMII EMAC (ESP32-S3, -C3, -C5, -C6)
                that use a WIZnet W5500 SPI-to-Ethernet chip instead.
        config UPLINK_USB_MODEM_PPP
            bool "USB 4G modem, PPP / AT commands (Quectel, SIMCom, Air780E...)"
            depends on SOC_USB_OTG_SUPPORTED
            help
                LTE modules that expose a serial modem interface and dial
                with PPP. Uses the iot_usbh_modem driver. The chip's USB port
                becomes a USB host, so the console moves to UART0.
        config UPLINK_USB_MODEM_NET
            bool "USB 4G modem, network card RNDIS / ECM (Huawei HiLink...)"
            depends on SOC_USB_OTG_SUPPORTED
            help
                Modems that show up as a USB network adapter and hand out an
                address via DHCP (e.g. Huawei E3372h in HiLink mode, web UI at
                192.168.8.1). The chip's USB port becomes a USB host, so the
                console moves to UART0.
    endchoice

    config USB_MODEM_UPLINK
        bool
        default y if UPLINK_USB_MODEM_PPP || UPLINK_USB_MODEM_NET

    choice USB_MODEM_NET_PROTO
        prompt "Network-card protocol"
        default USB_MODEM_NET_RNDIS
        depends on UPLINK_USB_MODEM_NET
        config USB_MODEM_NET_RNDIS
            bool "RNDIS (most Huawei/ZTE HiLink sticks, many Android-style modems)"
        config USB_MODEM_NET_ECM
            bool "CDC-ECM (Linux-style modems, some Quectel/Fibocom in ECM mode)"
    endchoice

    config USB_MODEM_APN
        string "APN (empty = use the modem's default)"
        default ""
        depends on UPLINK_USB_MODEM_PPP
        help
            Leave empty for most SIM cards. Examples: internet.mts.ru,
            internet.beeline.ru, internet (MegaFon), internet.tele2.ru.

    config USB_MODEM_CUSTOM_VID
        hex "Extra modem USB VID (0 = none)"
        default 0x0
        depends on UPLINK_USB_MODEM_PPP
        help
            Add a modem that is not in the built-in list. Look up VID/PID and
            the interface numbers of its PPP (modem) and AT ports, e.g. with
            Linux "lsusb -v" or the modem's documentation.

    config USB_MODEM_CUSTOM_PID
        hex "Extra modem USB PID"
        default 0x0
        depends on UPLINK_USB_MODEM_PPP && USB_MODEM_CUSTOM_VID != 0x0

    config USB_MODEM_CUSTOM_MODEM_ITF
        int "Extra modem: PPP (modem) interface number"
        default 2
        depends on UPLINK_USB_MODEM_PPP && USB_MODEM_CUSTOM_VID != 0x0

    config USB_MODEM_CUSTOM_AT_ITF
        int "Extra modem: AT interface number (-1 = none)"
        default -1
        depends on UPLINK_USB_MODEM_PPP && USB_MODEM_CUSTOM_VID != 0x0

    config ETH_MDC_GPIO
        int "ETH MDC GPIO"
        default 23
        depends on ETH_UPLINK && ETH_PHY_RMII_LAN8720

    config ETH_MDIO_GPIO
        int "ETH MDIO GPIO"
        default 18
        depends on ETH_UPLINK && ETH_PHY_RMII_LAN8720

    config ETH_PHY_ADDR
        int "ETH PHY address"
        default 1
        depends on ETH_UPLINK && ETH_PHY_RMII_LAN8720

    config ETH_PHY_POWER_GPIO
        int "ETH PHY power GPIO (-1 for none)"
        default 16
        depends on ETH_UPLINK && ETH_PHY_RMII_LAN8720

    config ETH_RMII_CLK_OUTPUT_GPIO
        int "RMII clock output GPIO (-1 = input from PHY)"
        default -1
        depends on ETH_UPLINK && ETH_PHY_RMII_LAN8720
        help
            Set to the GPIO number on which the ESP32 should generate the 50 MHz
            RMII reference clock (e.g. GPIO 17 for the Olimex ESP32-POE-ISO).
            Leave at -1 when the PHY provides the clock (e.g. WT32-ETH01).

    config ETH_SPI_HOST
        int "SPI host (1=SPI2/HSPI, 2=SPI3/VSPI)"
        default 1
        range 1 2
        depends on ETH_UPLINK && ETH_PHY_SPI_W5500

    config ETH_SPI_CLOCK_MHZ
        int "SPI clock speed (MHz)"
        default 20
        range 1 80
        depends on ETH_UPLINK && ETH_PHY_SPI_W5500
        help
            W5500 is rated up to 80 MHz, but most breakout boards and
            jumper-wire hookups are more reliable around 20-33 MHz.

    config ETH_SPI_MISO_GPIO
        int "W5500 MISO GPIO"
        default 12
        depends on ETH_UPLINK && ETH_PHY_SPI_W5500

    config ETH_SPI_MOSI_GPIO
        int "W5500 MOSI GPIO"
        default 11
        depends on ETH_UPLINK && ETH_PHY_SPI_W5500

    config ETH_SPI_SCLK_GPIO
        int "W5500 SCLK GPIO"
        default 13
        depends on ETH_UPLINK && ETH_PHY_SPI_W5500

    config ETH_SPI_CS_GPIO
        int "W5500 CS GPIO"
        default 14
        depends on ETH_UPLINK && ETH_PHY_SPI_W5500

    config ETH_SPI_INT_GPIO
        int "W5500 INT GPIO"
        default 10
        depends on ETH_UPLINK && ETH_PHY_SPI_W5500

    config ETH_SPI_RST_GPIO
        int "W5500 RST GPIO (-1 for none)"
        default 9
        depends on ETH_UPLINK && ETH_PHY_SPI_W5500

endmenu

menu "NAT Router Board Defaults"

    config DEFAULT_LED_STRIP_GPIO
        int "Addressable status LED GPIO if none is configured (-1 = off)"
        default -1
        help
            Used only until the LED GPIO has been set with the console or web
            UI; a value saved there (including -1 = off) takes precedence.

    config ROUTER_AP_MAX_CONNECTIONS
        int "Max WiFi clients (0 = per-chip default)"
        default 0
        range 0 15
        help
            15 is the ESP-IDF soft-AP limit. Each client uses about 5 KB of
            RAM, so raise it only on boards with PSRAM.

endmenu

menu "MQTT Home Assistant"

    config MQTT_HOMEASSISTANT
        bool "Enable MQTT Home Assistant integration"
        default y
        help
            Publishes router telemetry to an MQTT broker with
            Home Assistant auto-discovery. Adds ~58 KB flash.
            RAM is only used when a broker is configured and enabled.

    config MQTT_HA_BUFFER_SIZE
        int "MQTT buffer size (bytes)"
        default 1024
        depends on MQTT_HOMEASSISTANT

    config MQTT_DEFAULT_INTERVAL
        int "Default publish interval (seconds)"
        default 30
        depends on MQTT_HOMEASSISTANT
        range 5 3600

endmenu
```
